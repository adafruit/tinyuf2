## ports/espressif/apps/dfu_runtime/sdkconfig.defaults
```kconfig
CONFIG_IDF_CMAKE=y
CONFIG_FREERTOS_SUPPORT_STATIC_ALLOCATION=y

# Compiler options
CONFIG_COMPILER_OPTIMIZATION_SIZE=y
CONFIG_COMPILER_OPTIMIZATION_ASSERTIONS_SILENT=y

# Serial flasher config
CONFIG_ESPTOOLPY_FLASHMODE_QIO=y
```

## ports/espressif/apps/update_tinyuf2/sdkconfig.defaults
```kconfig
CONFIG_IDF_CMAKE=y
CONFIG_FREERTOS_WATCHPOINT_END_OF_STACK=y
CONFIG_FREERTOS_SUPPORT_STATIC_ALLOCATION=y

# Compiler options
CONFIG_COMPILER_OPTIMIZATION_SIZE=y
CONFIG_COMPILER_OPTIMIZATION_ASSERTIONS_SILENT=y

# Serial flasher config
CONFIG_ESPTOOLPY_FLASHMODE_QIO=y
```

## ports/espressif/sdkconfig.defaults
```kconfig
CONFIG_IDF_CMAKE=y
CONFIG_FREERTOS_SUPPORT_STATIC_ALLOCATION=y

# Partition Table
CONFIG_PARTITION_TABLE_CUSTOM=y
CONFIG_PARTITION_TABLE_OFFSET=0x8000
CONFIG_PARTITION_TABLE_MD5=y

# Compiler options
CONFIG_COMPILER_OPTIMIZATION_SIZE=y
CONFIG_COMPILER_OPTIMIZATION_ASSERTIONS_SILENT=y

# Serial flasher config
CONFIG_ESPTOOLPY_FLASHMODE_QIO=y
```
