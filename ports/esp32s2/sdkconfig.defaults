## ports/esp32s2/sdkconfig.defaults
```kconfig
CONFIG_IDF_CMAKE=y
CONFIG_FREERTOS_WATCHPOINT_END_OF_STACK=y
CONFIG_FREERTOS_SUPPORT_STATIC_ALLOCATION=y

# Partition Table
CONFIG_PARTITION_TABLE_CUSTOM=y
CONFIG_PARTITION_TABLE_OFFSET=0x8000
CONFIG_PARTITION_TABLE_MD5=y

# Compiler options
CONFIG_COMPILER_OPTIMIZATION_SIZE=y
CONFIG_COMPILER_OPTIMIZATION_ASSERTIONS_SILENT=y

# Newlib
CONFIG_NEWLIB_NANO_FORMAT=y

# Virtual file system
CONFIG_VFS_SUPPORT_IO=n

# Compatibility options
CONFIG_FLASHMODE_QIO=y
```

## ports/espressif/apps/blinky/sdkconfig.defaults
```kconfig
CONFIG_IDF_CMAKE=y
CONFIG_FREERTOS_WATCHPOINT_END_OF_STACK=y
CONFIG_FREERTOS_SUPPORT_STATIC_ALLOCATION=y

# Compiler options
CONFIG_COMPILER_OPTIMIZATION_SIZE=y
CONFIG_COMPILER_OPTIMIZATION_ASSERTIONS_SILENT=y

# Newlib
CONFIG_NEWLIB_NANO_FORMAT=y

# Virtual file system
CONFIG_VFS_SUPPORT_IO=n

# Compatibility options
CONFIG_FLASHMODE_QIO=y
```

## ports/espressif/components/ssd1306/Kconfig.projbuild
```kconfig
menu "SSD1306 Configuration"

	config GPIO_RANGE_MAX
		int
		default 33 if IDF_TARGET_ESP32
		default 46 if IDF_TARGET_ESP32S2
		default 19 if IDF_TARGET_ESP32C3
		default 48 if IDF_TARGET_ESP32S3

	choice INTERFACE
		prompt "Interface"
		default I2C_INTERFACE
		help
			Select Interface.
		config I2C_INTERFACE
			bool "I2C Interface"
			help
				I2C Interface.
		config SPI_INTERFACE
			bool "SPI Interface"
			help
				SPI Interface.
	endchoice

	choice PANEL
		prompt "Panel Type"
		default SSD1306_128x64
		help
			Select Panel Type.
		config SSD1306_128x32
			bool "128x32 Panel"
			help
				Panel is 128x32.
		config SSD1306_128x64
			bool "128x64 Panel"
			help
				Panel is 128x64.
	endchoice

	config OFFSETX
		int "GRAM X OFFSET"
		range 0 99
		default 2
		help
			When your TFT have offset(X), set it.

	config FLIP
		bool "Flip upside down"
		default false
		help
			Flip upside down.

	config SCL_GPIO
		depends on I2C_INTERFACE
		int "SCL GPIO number"
		range 0 GPIO_RANGE_MAX
		default 22 if IDF_TARGET_ESP32
		default 12 if IDF_TARGET_ESP32S2
		default 18 if IDF_TARGET_ESP32S3
		default  9 if IDF_TARGET_ESP32C3
		help
			GPIO number (IOxx) to I2C SCL.
			Some GPIOs are used for other purposes (flash connections, etc.) and cannot be used to I2C.
			GPIOs 35-39 are input-only so cannot be used as outputs.

	config SDA_GPIO
		depends on I2C_INTERFACE
		int "SDA GPIO number"
		range 0 GPIO_RANGE_MAX
		default 21 if IDF_TARGET_ESP32
		default 11 if IDF_TARGET_ESP32S2
		default 17 if IDF_TARGET_ESP32S3
		default 10 if IDF_TARGET_ESP32C3
		help
			GPIO number (IOxx) to I2C SDA.
			Some GPIOs are used for other purposes (flash connections, etc.) and cannot be used to I2C.
			GPIOs 35-39 are input-only so cannot be used as outputs.

	config RESET_GPIO
		int "RESET GPIO number"
		range -1 GPIO_RANGE_MAX
		default 33 if IDF_TARGET_ESP32
		default 38 if IDF_TARGET_ESP32S2
		default -1 if IDF_TARGET_ESP32S3
		default  3 if IDF_TARGET_ESP32C3
		help
			GPIO number (IOxx) to RESET.
			When it is -1, RESET isn't performed.
			Some GPIOs are used for other purposes (flash connections, etc.) and cannot be used to Reset.
			GPIOs 35-39 are input-only so cannot be used as outputs.

	config MOSI_GPIO
		depends on SPI_INTERFACE
		int "MOSI GPIO number"
		range 0 GPIO_RANGE_MAX
		default 23 if IDF_TARGET_ESP32
		default 35 if IDF_TARGET_ESP32S2
		default 35 if IDF_TARGET_ESP32S3
		default  0 if IDF_TARGET_ESP32C3
		help
			GPIO number (IOxx) to SPI MOSI.
			Some GPIOs are used for other purposes (flash connections, etc.) and cannot be used to DC.
			On the ESP32, GPIOs 35-39 are input-only so cannot be used as outputs.
			On the ESP32-S2, GPIO 46 is input-only so cannot be used as outputs.

	config SCLK_GPIO
		depends on SPI_INTERFACE
		int "SCLK GPIO number"
		range 0 GPIO_RANGE_MAX
		default 18 if IDF_TARGET_ESP32
		default 36 if IDF_TARGET_ESP32S2
		default 36 if IDF_TARGET_ESP32S3
		default  1 if IDF_TARGET_ESP32C3
		help
			GPIO number (IOxx) to SPI SCLK.
			Some GPIOs are used for other purposes (flash connections, etc.) and cannot be used to DC.
			On the ESP32, GPIOs 35-39 are input-only so cannot be used as outputs.
			On the ESP32-S2, GPIO 46 is input-only so cannot be used as outputs.

	config CS_GPIO
		depends on SPI_INTERFACE
		int "CS GPIO number"
		range 0 GPIO_RANGE_MAX
		default  5 if IDF_TARGET_ESP32
		default 34 if IDF_TARGET_ESP32S2
		default 34 if IDF_TARGET_ESP32S3
		default 10 if IDF_TARGET_ESP32C3
		help
			GPIO number (IOxx) to SPI CS.
			Some GPIOs are used for other purposes (flash connections, etc.) and cannot be used to CS.
			GPIOs 35-39 are input-only so cannot be used as outputs.

	config DC_GPIO
		depends on SPI_INTERFACE
		int "DC GPIO number"
		range 0 GPIO_RANGE_MAX
		default 27 if IDF_TARGET_ESP32
		default 37 if IDF_TARGET_ESP32S2
		default 37 if IDF_TARGET_ESP32S3
		default  2 if IDF_TARGET_ESP32C3
		help
			GPIO number (IOxx) to SPI DC.
			Some GPIOs are used for other purposes (flash connections, etc.) and cannot be used to DC.
			GPIOs 35-39 are input-only so cannot be used as outputs.

endmenu
```

## sdkconfig.defaults
```kconfig
CONFIG_IDF_CMAKE=y
CONFIG_IDF_TARGET="esp32s2"
CONFIG_IDF_TARGET_ESP32S2=y
CONFIG_FREERTOS_WATCHPOINT_END_OF_STACK=y
CONFIG_FREERTOS_SUPPORT_STATIC_ALLOCATION=y

# Partition Table
CONFIG_PARTITION_TABLE_CUSTOM=y
CONFIG_PARTITION_TABLE_CUSTOM_FILENAME="partitions.csv"
CONFIG_PARTITION_TABLE_FILENAME="partitions.csv"
CONFIG_PARTITION_TABLE_OFFSET=0x8000
CONFIG_PARTITION_TABLE_MD5=y

# Serial flasher config
CONFIG_ESPTOOLPY_FLASHSIZE_4MB=y

# TODO currently uf2 usb only enumerated with 921600 but failed with 115200
# There is probably a race condition somewhere
CONFIG_ESP_CONSOLE_UART_BAUDRATE=921600
CONFIG_MONITOR_BAUD_921600B=y
```
